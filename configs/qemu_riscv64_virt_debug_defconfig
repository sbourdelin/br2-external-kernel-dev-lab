## configs/qemu_riscv64_virt_debug_defconfig
```kconfig
BR2_riscv=y
BR2_GLOBAL_PATCH_DIR="$(BR2_EXTERNAL_KERNEL_DEV_LAB_PATH)/patches"
BR2_ENABLE_DEBUG=y
BR2_PACKAGE_HOST_LINUX_HEADERS_CUSTOM_5_10=y
BR2_TOOLCHAIN_BUILDROOT_WCHAR=y
BR2_PTHREAD_DEBUG=y
BR2_SYSTEM_DHCP="eth0"
BR2_ROOTFS_POST_BUILD_SCRIPT="$(BR2_EXTERNAL_KERNEL_DEV_LAB_PATH)/board/qemu-riscv64-virt-debug/post-build.sh"
BR2_ROOTFS_POST_IMAGE_SCRIPT="$(BR2_EXTERNAL_KERNEL_DEV_LAB_PATH)/board/qemu-riscv64-virt-debug/post-image.sh"
BR2_ROOTFS_POST_SCRIPT_ARGS="$(BR2_DEFCONFIG)"
BR2_LINUX_KERNEL=y
BR2_LINUX_KERNEL_CUSTOM_VERSION=y
BR2_LINUX_KERNEL_CUSTOM_VERSION_VALUE="5.10.7"
BR2_LINUX_KERNEL_USE_CUSTOM_CONFIG=y
BR2_LINUX_KERNEL_CUSTOM_CONFIG_FILE="$(BR2_EXTERNAL_KERNEL_DEV_LAB_PATH)/board/qemu-riscv64-virt-debug/linux.config"
BR2_PACKAGE_GDB=y
BR2_TARGET_ROOTFS_EXT2=y
BR2_TARGET_OPENSBI=y
BR2_TARGET_OPENSBI_PLAT="generic"
BR2_PACKAGE_HOST_QEMU=y
BR2_PACKAGE_HOST_QEMU_SYSTEM_MODE=y
BR2_PACKAGE_KMOD_EXAMPLE=y
```

## configs/qemu_x86_64_debug_defconfig
```kconfig
BR2_x86_64=y
BR2_GLOBAL_PATCH_DIR="$(BR2_EXTERNAL_KERNEL_DEV_LAB_PATH)/patches"
BR2_PACKAGE_HOST_LINUX_HEADERS_CUSTOM_5_10=y
BR2_TOOLCHAIN_BUILDROOT_WCHAR=y
BR2_PTHREAD_DEBUG=y
BR2_TOOLCHAIN_BUILDROOT_CXX=y
BR2_SYSTEM_DHCP="eth0"
BR2_ROOTFS_POST_BUILD_SCRIPT="$(BR2_EXTERNAL_KERNEL_DEV_LAB_PATH)/board/qemu-x86_64-debug/post-build.sh"
BR2_ROOTFS_POST_IMAGE_SCRIPT="$(BR2_EXTERNAL_KERNEL_DEV_LAB_PATH)/board/qemu-x86_64-debug/post-image.sh"
BR2_ROOTFS_POST_SCRIPT_ARGS="$(BR2_DEFCONFIG)"
BR2_LINUX_KERNEL=y
BR2_LINUX_KERNEL_CUSTOM_VERSION=y
BR2_LINUX_KERNEL_CUSTOM_VERSION_VALUE="5.10.7"
BR2_LINUX_KERNEL_USE_CUSTOM_CONFIG=y
BR2_LINUX_KERNEL_CUSTOM_CONFIG_FILE="$(BR2_EXTERNAL_KERNEL_DEV_LAB_PATH)/board/qemu-x86_64-debug/linux.config"
BR2_PACKAGE_GDB=y
BR2_TARGET_ROOTFS_EXT2=y
# BR2_TARGET_ROOTFS_TAR is not set
BR2_PACKAGE_HOST_QEMU=y
BR2_PACKAGE_HOST_QEMU_SYSTEM_MODE=y
BR2_PACKAGE_KMOD_EXAMPLE=y
```

## package/kernel-modules/Config.in
```kconfig
menu "Kernel modules"
	source "$BR2_EXTERNAL_KERNEL_DEV_LAB_PATH/package/kernel-modules/kmod-example/Config.in"
endmenu
```

## package/kernel-modules/kmod-example/Config.in
```kconfig
config BR2_PACKAGE_KMOD_EXAMPLE
	bool "kmod-example"
	depends on BR2_LINUX_KERNEL
	help
		Example kernel module
```
